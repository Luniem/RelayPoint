## components/mqtt_handler/Kconfig
```kconfig
config MQTT_BROKER_URI
    string "MQTT Broker URI"
    default "mqtt://localhost"
    help
        URI of the MQTT broker to connect to

config MQTT_USE_AUTH
    bool "Use MQTT authentication"
    default n

config MQTT_USERNAME
    string "MQTT Username"
    help
        MQTT broker username (optional)

config MQTT_PASSWORD
    string "MQTT Password"
    help
        MQTT broker password (optional)
```

## components/wifi_handler/Kconfig
```kconfig
config WIFI_SSID
    string "WIFI SSID"
    default ""
    help
        SSID of the AP connecting to

config WIFI_PASSWORD
    string "WIFI password"
    default ""
    help
        Password of the AP connecting to

config WIFI_MAXIMUM_RETRY
    int "WIFI maximum retries"
    default 3
    help
        How often should be tried to reconnect to the AP
```
